## boards/shields/nice_view_custom/Kconfig.defconfig
```kconfig
# SPDX-License-Identifier: MIT

if SHIELD_NICE_VIEW_CUSTOM

# -----------------------------------------------------------------------------
# Animation timing
# -----------------------------------------------------------------------------
config CUSTOM_ANIMATION_SPEED
    int "Total duration in milliseconds for animation to take"
    default 3000000

# -----------------------------------------------------------------------------
# LVGL tuning
# -----------------------------------------------------------------------------
config LV_Z_VDB_SIZE
    default 100

config LV_DPI_DEF
    default 161

config LV_Z_MEM_POOL_SIZE
    default 4096 if ZMK_DISPLAY_STATUS_SCREEN_CUSTOM

# -----------------------------------------------------------------------------
# LVGL COLOR DEPTH
#
# IMPORTANT:
# - This is DISPLAY color depth
# - Indexed images do NOT require 2-bit depth here
# - 1-bit is correct for SSD1306 / nice_view
# -----------------------------------------------------------------------------
choice LV_COLOR_DEPTH
    default LV_COLOR_DEPTH_1
endchoice

# -----------------------------------------------------------------------------
# ZMK display configuration
# -----------------------------------------------------------------------------
choice ZMK_DISPLAY_WORK_QUEUE
    default ZMK_DISPLAY_WORK_QUEUE_DEDICATED
endchoice

choice ZMK_DISPLAY_STATUS_SCREEN
    default ZMK_DISPLAY_STATUS_SCREEN_CUSTOM
endchoice

# -----------------------------------------------------------------------------
# nice_view custom widgets
# -----------------------------------------------------------------------------
config ZMK_DISPLAY_STATUS_SCREEN_CUSTOM
    imply NICE_VIEW_WIDGET_STATUS

config NICE_VIEW_WIDGET_STATUS
    bool "Custom nice!view status widget"
    select LV_FONT_MONTSERRAT_16
    select LV_FONT_MONTSERRAT_18
    select LV_FONT_MONTSERRAT_14
    select LV_FONT_UNSCII_8
    select LV_USE_IMG
    select LV_USE_CANVAS
    select LV_USE_ANIMIMG
    select LV_USE_ANIMATION
    select ZMK_WPM

config NICE_VIEW_WIDGET_INVERTED
    bool "Invert custom status widget colors"

# -----------------------------------------------------------------------------
# Split keyboard handling
# -----------------------------------------------------------------------------
if !ZMK_SPLIT || ZMK_SPLIT_ROLE_CENTRAL
config NICE_VIEW_WIDGET_STATUS
endif

endif # SHIELD_NICE_VIEW_CUSTOM
```
